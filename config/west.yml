## config/west.yml
```yaml
manifest:
  remotes:
    - name: zmkfirmware
      url-base: https://github.com/zmkfirmware
    - name: scybin
      url-base: https://github.com/scybin
    - name: nuovotaka
      url-base: https://github.com/nuovotaka
  projects:
    - name: zmk
      remote: zmkfirmware
      revision: v0.3.0
      import: app/west.yml
    - name: zmk-keyboard-chitin
      remote: scybin
      revision: main
    - name: zmk-driver-pim447
      remote: scybin
      revision: master
    - name: zmk-pointing-acceleration-alpha
      remote: nuovotaka
      revision: main
  self:
    path: config
```
